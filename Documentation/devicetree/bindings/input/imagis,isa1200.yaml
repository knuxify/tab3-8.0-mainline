## Documentation/devicetree/bindings/input/imagis,isa1200.yaml
```yaml
# SPDX-License-Identifier: (GPL-2.0-only OR BSD-2-Clause)
%YAML 1.2
---
$id: http://devicetree.org/schemas/input/imagis,isa1200.yaml#
$schema: http://devicetree.org/meta-schemas/core.yaml#

title: Imagis ISA1200 Haptic Feedback Unit

maintainers:
  - Linus Walleij <linus.walleij@linaro.org>

description:
  The Imagis ISA1200 is a haptic feedback chip using two motors of
  LRA or ERM type. It can generate a PWM signal to control the motors from
  a fixed input clock, or it can amplify and modify an existing PWM
  input. It is communicating with the host system using I2C.

properties:
  compatible:
    const: imagis,isa1200

  reg:
    description: I2C address for the ISA1200

  hen-gpios:
    description: GPIO line that drives the HEN (Motor Hardware Enable) pin
      on the chip.
    maxItems: 1

  len-gpios:
    description: GPIO line that drives the LEN (LDO Enable) pin on the chip.
    maxItems: 1

  clocks:
    description: Clock that drives the chip if using the chip to generate a
      PWM from a clock. Either clocks or pwms must be defined.
    maxItems: 1

  pwms:
    description: PWM that drives the chip if using an external PWM generator.
      Either pwms or clocks must be defined.
    maxItems: 1

  imagis,ldo-voltage-millivolt:
    $ref: /schemas/types.yaml#/definitions/uint16
    description: The voltage to be supplied to the motor in millivolts.
    minimum: 2300
    maximum: 3800
    multipleOf: 100

  imagis,clock-divider:
    $ref: /schemas/types.yaml#/definitions/uint16
    description: The clock divider used for the incoming clock signal.
    enum:
      - 128
      - 256
      - 512
      - 1024
    default: 128

  imagis,pll-divider:
    $ref: /schemas/types.yaml#/definitions/uint8
    description: The PLL divider used to generate the PWM signal.

  imagis,pwm-frequency:
    $ref: /schemas/types.yaml#/definitions/uint8
    description: The frequency of the PWM signal generated by the chip.

  imagis,pwm-duty:
    $ref: /schemas/types.yaml#/definitions/uint8
    description: The duty cycle of the PWM signal generated by the chip.

  imagis,pwm-period:
    $ref: /schemas/types.yaml#/definitions/uint8
    description: The period of the PWM signal generated by the chip.

required:
    - compatible
    - reg
    - len-gpios
    - imagis,ldo-voltage-millivolt

not:
  required:
    - pwms
    - clocks

oneOf:
  - required:
    - pwms
  - required:
    - clocks
    - imagis,pll-divider
    - imagis,pwm-frequency
    - imagis,pwm-duty
    - imagis,pwm-period

additionalProperties: false

examples:
  - |
    #include <dt-bindings/gpio/gpio.h>

    i2c {
      #address-cells = <1>;
      #size-cells = <0>;

      haptic@49 {
        compatible = "imagis,isa1200";
        reg = <0x49>;
        hen-gpios = <&gpio6 2 GPIO_ACTIVE_HIGH>;
        len-gpios = <&gpio6 3 GPIO_ACTIVE_HIGH>;
        clocks = <&clkout_clk>;
        imagis,ldo-voltage-millivolt = /bits/ 16 <3000>;
        imagis,clock-divider = /bits/ 16 <256>;
        imagis,pll-divider = /bits/ 8 <2>;
        imagis,pwm-frequency = /bits/ 8 <100>;
        imagis,pwm-duty = /bits/ 8 <50>;
        imagis,pwm-period = /bits/ 8 <100>;
      };
    };
```

## Documentation/devicetree/bindings/interconnect/qcom,netrani-rpmh.yaml
```yaml
# SPDX-License-Identifier: (GPL-2.0 OR BSD-2-Clause)
%YAML 1.2
---
$id: http://devicetree.org/schemas/interconnect/qcom,netrani-rpmh.yaml#
$schema: http://devicetree.org/meta-schemas/core.yaml#

title: Qualcomm RPMh Network-On-Chip Interconnect on Netrani SoC

maintainers:
  - Artur Weber <aweber.kernel@gmail.com>

description: |
  RPMh interconnect providers support system bandwidth requirements through
  RPMh hardware accelerators known as Bus Clock Manager (BCM). The provider is
  able to communicate with the BCM through the Resource State Coordinator (RSC)
  associated with each execution environment. Provider nodes must point to at
  least one RPMh device child node pertaining to their RSC and each provider
  can map to multiple RPMh resources.

  See also: include/dt-bindings/interconnect/qcom,netrani-rpmh.h

properties:
  compatible:
    enum:
      - qcom,netrani-aggre1-noc
      - qcom,netrani-aggre2-noc
      - qcom,netrani-clk-virt
      - qcom,netrani-cnoc2
      - qcom,netrani-cnoc3
      - qcom,netrani-gem-noc
      - qcom,netrani-lpass-ag-noc
      - qcom,netrani-mc-virt
      - qcom,netrani-mmss-noc
      - qcom,netrani-nsp-noc
      - qcom,netrani-pcie-anoc
      - qcom,netrani-system-noc

  reg:
    maxItems: 1

  clocks:
    minItems: 1
    maxItems: 2

required:
  - compatible

allOf:
  - $ref: qcom,rpmh-common.yaml#
  - if:
      properties:
        compatible:
          contains:
            enum:
              - qcom,netrani-clk-virt
              - qcom,netrani-mc-virt
    then:
      properties:
        reg: false
    else:
      required:
        - reg

  - if:
      properties:
        compatible:
          contains:
            enum:
              - qcom,netrani-pcie-anoc
    then:
      properties:
        clocks:
          items:
            - description: aggre-NOC PCIe AXI clock
            - description: cfg-NOC PCIe a-NOC AHB clock

  - if:
      properties:
        compatible:
          contains:
            enum:
              - qcom,netrani-aggre1-noc
    then:
      properties:
        clocks:
          items:
            - description: aggre USB3 PRIM AXI clock
            - description: aggre UFS PHY AXI clock

  - if:
      properties:
        compatible:
          contains:
            enum:
              - qcom,netrani-aggre2-noc
    then:
      properties:
        clocks:
          items:
            - description: RPMH CC IPA clock

  - if:
      properties:
        compatible:
          contains:
            enum:
              - qcom,netrani-aggre1-noc
              - qcom,netrani-aggre2-noc
              - qcom,netrani-pcie-anoc
    then:
      required:
        - clocks
    else:
      properties:
        clocks: false

unevaluatedProperties: false

examples:
  - |
    #include <dt-bindings/clock/qcom,netrani-gcc.h>

    interconnect-0 {
        compatible = "qcom,netrani-clk-virt";
        #interconnect-cells = <2>;
        qcom,bcm-voters = <&apps_bcm_voter>;
    };

    interconnect@16e0000 {
        compatible = "qcom,netrani-aggre1-noc";
        reg = <0x016e0000 0x16400>;
        #interconnect-cells = <2>;
        clocks = <&gcc GCC_AGGRE_USB3_PRIM_AXI_CLK>,
                 <&gcc GCC_AGGRE_UFS_PHY_AXI_CLK>;
        qcom,bcm-voters = <&apps_bcm_voter>;
    };
```
